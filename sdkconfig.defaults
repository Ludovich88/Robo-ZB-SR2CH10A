## sdkconfig.defaults
```kconfig
# ESP32-C6 Smart Relay Default Configuration for ESP-IDF v5.3.2
# Device works as Zigbee Router with 4MB Flash

# Target Configuration
CONFIG_IDF_TARGET="esp32c6"

# Flash Configuration - 4MB Flash
CONFIG_ESPTOOLPY_FLASHSIZE_4MB=y
CONFIG_ESPTOOLPY_FLASHSIZE="4MB"

# UART Configuration
CONFIG_ESP_CONSOLE_UART_NUM=0
CONFIG_ESP_CONSOLE_UART_BAUDRATE=115200

# WiFi Configuration (disabled for Zigbee only)
CONFIG_ESP_WIFI_ENABLED=n

# Bluetooth Configuration (disabled for Zigbee only)
CONFIG_BT_ENABLED=n

# Zigbee Configuration - ROUTER MODE!
CONFIG_ZB_ENABLED=y
CONFIG_ZB_ZED=n
CONFIG_ZB_DEBUG_MODE=n
CONFIG_ZB_RADIO_SPINEL_UART=n

# IEEE 802.15.4 Configuration
CONFIG_IEEE802154_ENABLED=y
CONFIG_IEEE802154_RX_BUFFER_SIZE=127

# Logging Configuration
CONFIG_LOG_DEFAULT_LEVEL_INFO=y
CONFIG_LOG_DEFAULT_LEVEL=3

# FreeRTOS Configuration
CONFIG_FREERTOS_HZ=1000
CONFIG_FREERTOS_USE_TRACE_FACILITY=y
CONFIG_FREERTOS_USE_STATS_FORMATTING_FUNCTIONS=y

# NVS Configuration - completely disable security
CONFIG_NVS_ENCRYPTION=n
CONFIG_NVS_SECURITY_ENABLED=n
CONFIG_NVS_SEC_PROVIDER_EFUSE_KEY=n
CONFIG_NVS_SEC_HMAC_EFUSE_KEY_ID=0
CONFIG_NVS_SEC_PROVIDER_EFUSE_KEY_ID=0

# Partition Table Configuration
CONFIG_PARTITION_TABLE_CUSTOM=y
CONFIG_PARTITION_TABLE_SINGLE_APP=n
CONFIG_PARTITION_TABLE_CUSTOM_FILENAME="partitions.csv"
CONFIG_PARTITION_TABLE_FILENAME="partitions.csv"
```
